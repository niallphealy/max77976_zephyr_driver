## charger/max77976/Kconfig
```kconfig
config MAX77976
	bool "MAX77976 battery charger driver"
	default y
	depends on DT_HAS_MAXIM_MAX77976_ENABLED
	select I2C
	help
	  Enable the MAX77976 battery charger driver.
```

## dts/bindings/maxim,max77976.yaml
```yaml
description: Maxim MAX77976 charger

include: ["battery.yaml", "i2c-device.yaml"]

compatible: "maxim,max77976"
```
